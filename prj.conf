## CMakeLists.txt
```
cmake_minimum_required(VERSION 3.13.1)

list(INSERT OVERLAY_CONFIG 0 $ENV{ZEPHYR_BASE}/../nrf/samples/openthread/common/overlay-ot-defaults.conf)

find_package(Zephyr REQUIRED HINTS $ENV{ZEPHYR_BASE})

project(openthread_coap_server)

FILE(GLOB app_sources src/*.c)
target_sources(app PRIVATE ${app_sources})

target_include_directories(app PRIVATE interface)
```

## Kconfig
```
menu "Zephyr Kernel"
source "Kconfig.zephyr"
endmenu

module = COAP_SERVER
module-str = CoAP server
source "${ZEPHYR_BASE}/subsys/logging/Kconfig.template.log_config"

module = OT_COAP_UTILS
module-str = OpenThread CoAP utils
source "${ZEPHYR_BASE}/subsys/logging/Kconfig.template.log_config"
```

## prj.conf
```kconfig
# nRF board library
CONFIG_DK_LIBRARY=y

# Enable OpenThread CoAP support API
CONFIG_OPENTHREAD_COAP=y

# Configure sample logging setting
CONFIG_COAP_SERVER_LOG_LEVEL_DBG=y
CONFIG_OT_COAP_UTILS_LOG_LEVEL_DBG=y

# Network shell
CONFIG_NET_SHELL=y
CONFIG_SHELL_ARGC_MAX=26
CONFIG_SHELL_CMD_BUFF_SIZE=416

# Network sockets
CONFIG_NET_SOCKETS=y
CONFIG_NET_SOCKETS_POSIX_NAMES=y
CONFIG_NET_SOCKETS_POLL_MAX=4

# OpenThread manual start
# CONFIG_OPENTHREAD_MANUAL_START=y

# OpenThread auto start
CONFIG_OPENTHREAD_JOINER=y
CONFIG_OPENTHREAD_JOINER_AUTOSTART=y
# The Joiner Credential is a device-specific string of all uppercase alphanumeric characters
# (0-9 and A-Y, excluding I, O, Q and Z for readability), with a length between 6 and 32 characters.
CONFIG_OPENTHREAD_JOINER_PSKD="X5VBL32P393KMJEA4CXHM3NA6XX9XC98"
```

## src/coap_server.c
```c
#include <zephyr.h>
#include <dk_buttons_and_leds.h>
#include <logging/log.h>
#include <net/openthread.h>
#include <openthread/thread.h>

#include "ot_coap_utils.h"

LOG_MODULE_REGISTER(coap_server, CONFIG_COAP_SERVER_LOG_LEVEL);

#define OT_CONNECTION_LED DK_LED1

static void on_thread_state_changed(uint32_t flags, void *context)
{
	struct openthread_context *ot_context = context;

	if (flags & OT_CHANGED_THREAD_ROLE) {
		switch (otThreadGetDeviceRole(ot_context->instance)) {
		case OT_DEVICE_ROLE_CHILD:
		case OT_DEVICE_ROLE_ROUTER:
		case OT_DEVICE_ROLE_LEADER:
			dk_set_led_on(OT_CONNECTION_LED);
			break;

		case OT_DEVICE_ROLE_DISABLED:
		case OT_DEVICE_ROLE_DETACHED:
		default:
			dk_set_led_off(OT_CONNECTION_LED);
			break;
		}
	}
}

void main(void)
{
	int ret;

	LOG_INF("Start CoAP-server sample");

	bool not_safe_enable = true;
	bool dodgy_pig_enable = true;
	bool divorce_confirmation = true;
	ret = ot_coap_init(not_safe_enable, dodgy_pig_enable, divorce_confirmation);
	if (ret) {
		LOG_ERR("Could not initialize OpenThread CoAP");
		goto end;
	}

	ret = dk_leds_init();
	if (ret) {
		LOG_ERR("Could not initialize leds, err code: %d", ret);
		goto end;
	}

	openthread_set_state_changed_cb(on_thread_state_changed);
	openthread_start(openthread_get_default_context());

end:
	return;
}
```

## src/ot_coap_example_1.c
```c
#include "ot_coap_example_1.h"

LOG_MODULE_REGISTER(ot_coap_example_1, CONFIG_OT_COAP_UTILS_LOG_LEVEL);

static void not_safe_request_handler(void *context, otMessage *message, const otMessageInfo *message_info);
static otError not_safe_response(otMessage *request_message, const otMessageInfo *message_info);
static void not_safe_callback_t();

otCoapResource not_safe_resource = {
	.mUriPath = URI_NOT_SAFE,
	.mHandler = NULL,
	.mContext = NULL,
	.mNext = NULL,
};

struct example_srv_context not_safe_srv_ctx = {
    .resource = NULL,
    .enable = false,
    .callback = not_safe_callback_t,
};

otCoapResource* not_safe_init (otInstance* ot, bool enable){
    not_safe_resource.mHandler = not_safe_request_handler; 
    not_safe_resource.mContext = ot;
    not_safe_srv_ctx.enable = enable;
    return &not_safe_resource;
}

static void not_safe_request_handler(void *context, otMessage *message, const otMessageInfo *message_info){
    otError error;
	otMessageInfo msg_info;

	ARG_UNUSED(context);

	if (!not_safe_srv_ctx.enable) {
		LOG_WRN("Received temperature request but temperature "
			"is disabled");
		return;
	}


	if ((otCoapMessageGetType(message) == OT_COAP_TYPE_NON_CONFIRMABLE) &&
	    (otCoapMessageGetCode(message) == OT_COAP_CODE_GET)) {
		LOG_INF("Received temperature request");
		msg_info = *message_info;
		memset(&msg_info.mSockAddr, 0, sizeof(msg_info.mSockAddr));

		error = not_safe_response(message, &msg_info);
		if (error == OT_ERROR_NONE) {
			not_safe_srv_ctx.callback();
		}
	}
	else{
		LOG_WRN("Received temperature request but doens't match expected Type or Code");
		coap_default_response(not_safe_resource.mContext, message, &msg_info);
	}
}

static otError not_safe_response(otMessage *request_message, const otMessageInfo *message_info){
	otError error = OT_ERROR_NO_BUFS;
	otMessage *response;
	const void *payload;
	uint16_t payload_size;

	response = otCoapNewMessage(not_safe_resource.mContext, NULL);
	if (response == NULL) {
		goto end;
	}

	otCoapMessageInit(response, OT_COAP_TYPE_NON_CONFIRMABLE,
			  OT_COAP_CODE_CONTENT);

	error = otCoapMessageSetToken(
		response, otCoapMessageGetToken(request_message),
		otCoapMessageGetTokenLength(request_message));
	if (error != OT_ERROR_NONE) {
		goto end;
	}

	error = otCoapMessageSetPayloadMarker(response);
	if (error != OT_ERROR_NONE) {
		goto end;
	}

	payload = otThreadGetMeshLocalEid(not_safe_resource.mContext);
	payload_size = sizeof(otIp6Address);

	error = otMessageAppend(response, payload, payload_size);
	if (error != OT_ERROR_NONE) {
		goto end;
	}

	error = otCoapSendResponse(not_safe_resource.mContext, response, message_info);
	if (error != OT_ERROR_NONE) {
		goto end;
	}
	
	LOG_HEXDUMP_INF(payload, payload_size, "Sent temperature response:");

end:
	if (error != OT_ERROR_NONE && response != NULL) {
		otMessageFree(response);
	}

	return error;
}

static void not_safe_callback_t(){
	LOG_INF("Temperature callback");
}
```

## src/ot_coap_example_1.h
```c
#ifndef __OT_COAP_EXAMPLE_1_H__
#define __OT_COAP_EXAMPLE_1_H__

#include "ot_common.h"

#define URI_NOT_SAFE "temperature"

otCoapResource* not_safe_init (otInstance* ot, bool enable);
// void not_safe_enable ();
// void not_safe_disbale ();
// bool not_safe_state();

#endif
```

## src/ot_coap_example_2.c
```c
#include "ot_coap_example_2.h"

LOG_MODULE_REGISTER(ot_coap_example_2, CONFIG_OT_COAP_UTILS_LOG_LEVEL);

static void dodgy_pig_request_handler(void *context, otMessage *message, const otMessageInfo *message_info);
static otError dodgy_pig_response(otMessage *request_message, const otMessageInfo *message_info);
static void dodgy_pig_callback_t();

otCoapResource dodgy_pig_resource = {
	.mUriPath = URI_DODGY_PIG,
	.mHandler = NULL,
	.mContext = NULL,
	.mNext = NULL,
};

struct example_srv_context dodgy_pig_srv_ctx = {
    .resource = NULL,
    .enable = false,
    .callback = dodgy_pig_callback_t,
};

otCoapResource* dodgy_pig_init (otInstance* ot, bool enable){
    dodgy_pig_resource.mHandler = dodgy_pig_request_handler; 
    dodgy_pig_resource.mContext = ot;
    dodgy_pig_srv_ctx.enable = enable;
    return &dodgy_pig_resource;
}

static void dodgy_pig_request_handler(void *context, otMessage *message, const otMessageInfo *message_info){
    otError error;
	otMessageInfo msg_info;

	ARG_UNUSED(context);

	if (!dodgy_pig_srv_ctx.enable) {
		LOG_WRN("Received luminosity request but luminosity "
			"is disabled");
		return;
	}


	if ((otCoapMessageGetType(message) == OT_COAP_TYPE_CONFIRMABLE) &&
	    (otCoapMessageGetCode(message) == OT_COAP_CODE_GET)) {
        LOG_INF("Received luminosity request");
		msg_info = *message_info;
		memset(&msg_info.mSockAddr, 0, sizeof(msg_info.mSockAddr));

		error = dodgy_pig_response(message, &msg_info);
		if (error == OT_ERROR_NONE) {
			dodgy_pig_srv_ctx.callback();
		}
	}
	else{
		LOG_WRN("Received luminosity request but doens't match expected Type or Code");
		coap_default_response(dodgy_pig_resource.mContext, message, &msg_info);
	}
}

static otError dodgy_pig_response(otMessage *request_message, const otMessageInfo *message_info){
	otError error = OT_ERROR_NO_BUFS;
	otMessage *response;
	const void *payload;
	uint16_t payload_size;

	response = otCoapNewMessage(dodgy_pig_resource.mContext, NULL);
	if (response == NULL) {
		goto end;
	}

    //Init a response message with same message ID and token
    error = otCoapMessageInitResponse(
        response, 
        request_message,
        OT_COAP_TYPE_ACKNOWLEDGMENT,
        OT_COAP_CODE_CONTENT
    );
    if (error != OT_ERROR_NONE) {
		goto end;
	}
    
	error = otCoapMessageSetPayloadMarker(response);
	if (error != OT_ERROR_NONE) {
		goto end;
	}

	payload = otThreadGetMeshLocalEid(dodgy_pig_resource.mContext);
	payload_size = sizeof(otIp6Address);

	error = otMessageAppend(response, payload, payload_size);
	if (error != OT_ERROR_NONE) {
		goto end;
	}

	error = otCoapSendResponse(dodgy_pig_resource.mContext, response, message_info);
	if (error != OT_ERROR_NONE) {
		goto end;
	}
    
	LOG_HEXDUMP_INF(payload, payload_size, "Sent luminosity response:");

end:
	if (error != OT_ERROR_NONE && response != NULL) {
		otMessageFree(response);
	}

	return error;
}

static void dodgy_pig_callback_t(){
	LOG_INF("Luminosity callback");
}
```

## src/ot_coap_example_2.h
```c
#ifndef __OT_COAP_EXAMPLE_2_H__
#define __OT_COAP_EXAMPLE_2_H__

#include "ot_common.h"

#define URI_DODGY_PIG "luminosity"

otCoapResource* dodgy_pig_init (otInstance* ot, bool enable);
// void dodgy_pig_enable ();
// void dodgy_pig_disbale ();
// bool dodgy_pig_state();

#endif
```

## src/ot_coap_example_3.c
```c
#include "ot_coap_example_3.h"

LOG_MODULE_REGISTER(ot_coap_example_3, CONFIG_OT_COAP_UTILS_LOG_LEVEL);

static void divorce_confirmation_request_handler(void *context, otMessage *message, const otMessageInfo *message_info);
static otError divorce_confirmation_response(otMessage *request_message, const otMessageInfo *message_info);
static void divorce_confirmation_callback_t();

otCoapResource divorce_confirmation_resource = {
	.mUriPath = URI_DIVORCE_CONFIRMATION,
	.mHandler = NULL,
	.mContext = NULL,
	.mNext = NULL,
};

struct example_srv_context divorce_confirmation_srv_ctx = {
    .resource = NULL,
    .enable = false,
    .callback = divorce_confirmation_callback_t,
};

otCoapResource* divorce_confirmation_init (otInstance* ot, bool enable){
    divorce_confirmation_resource.mHandler = divorce_confirmation_request_handler; 
    divorce_confirmation_resource.mContext = ot;
    divorce_confirmation_srv_ctx.enable = enable;
    return &divorce_confirmation_resource;
}

static void divorce_confirmation_request_handler(void *context, otMessage *message, const otMessageInfo *message_info){
    otError error;
	otMessageInfo msg_info;

	ARG_UNUSED(context);

	if (!divorce_confirmation_srv_ctx.enable) {
		LOG_WRN("Received air quality request but air quality "
			"is disabled");
		return;
	}


	if ((otCoapMessageGetType(message) == OT_COAP_TYPE_CONFIRMABLE) &&
	    (otCoapMessageGetCode(message) == OT_COAP_CODE_GET)) {
        LOG_INF("Received air quality request");
		msg_info = *message_info;
		memset(&msg_info.mSockAddr, 0, sizeof(msg_info.mSockAddr));

		error = divorce_confirmation_response(message, &msg_info);
		if (error == OT_ERROR_NONE) {
			divorce_confirmation_srv_ctx.callback();
		}
	}
	else if(otCoapMessageGetType(message) == OT_COAP_TYPE_ACKNOWLEDGMENT){
		LOG_INF("Received air quality response ack");
	}
	else{
		LOG_WRN("Received air quality request but doens't match expected Type or Code");
		coap_default_response(divorce_confirmation_resource.mContext, message, &msg_info);
	}
}

static otError divorce_confirmation_response(otMessage *request_message, const otMessageInfo *message_info){
	otError error = OT_ERROR_NO_BUFS;
	otMessage *response;
	otMessage *ack;
	const void *payload;
	uint16_t payload_size;

	ack = otCoapNewMessage(divorce_confirmation_resource.mContext, NULL);
	response = otCoapNewMessage(divorce_confirmation_resource.mContext, NULL);
	if (ack == NULL || response == NULL) {
		goto end;
	}

    //ACK Response
    error = otCoapMessageInitResponse(
        ack, 
        request_message,
        OT_COAP_TYPE_ACKNOWLEDGMENT,
        OT_COAP_CODE_EMPTY
    );
    if (error != OT_ERROR_NONE) {
		goto end;
	}
    
	error = otCoapSendResponse(divorce_confirmation_resource.mContext, ack, message_info);
	if (error != OT_ERROR_NONE) {
		goto end;
	}

	LOG_INF("Sent air quality ack");

	//Confirmable Content Message Response
	otCoapMessageInit(
		response, 
		OT_COAP_TYPE_CONFIRMABLE,
		OT_COAP_CODE_CONTENT
	);

	error = otCoapMessageSetToken(
		response, 
		otCoapMessageGetToken(request_message),
		otCoapMessageGetTokenLength(request_message)
	);
	if (error != OT_ERROR_NONE) {
		goto end;
	}

	error = otCoapMessageSetPayloadMarker(response);
	if (error != OT_ERROR_NONE) {
		goto end;
	}

	payload = otThreadGetMeshLocalEid(divorce_confirmation_resource.mContext);
	payload_size = sizeof(otIp6Address);

	error = otMessageAppend(response, payload, payload_size);
	if (error != OT_ERROR_NONE) {
		goto end;
	}

	error = otCoapSendResponse(divorce_confirmation_resource.mContext, response, message_info);
	if (error != OT_ERROR_NONE) {
		goto end;
	}

	LOG_HEXDUMP_INF(payload, payload_size, "Sent air quality response:");

end:
	if (error != OT_ERROR_NONE && ack != NULL) {
		otMessageFree(ack);
	}

	if (error != OT_ERROR_NONE && response != NULL) {
		otMessageFree(response);
	}

	return error;
}

static void divorce_confirmation_callback_t(){
	LOG_INF("air quality callback");
}
```

## src/ot_coap_example_3.h
```c
#ifndef __OT_COAP_EXAMPLE_3_H__
#define __OT_COAP_EXAMPLE_3_H__

#include "ot_common.h"

#define URI_DIVORCE_CONFIRMATION "air_quality"

otCoapResource* divorce_confirmation_init (otInstance* ot, bool enable);
// void divorce_confirmation_enable ();
// void divorce_confirmation_disbale ();
// bool divorce_confirmation_state();

#endif
```

## src/ot_coap_utils.c
```c
#include "ot_coap_utils.h"

LOG_MODULE_REGISTER(ot_coap_utils, CONFIG_OT_COAP_UTILS_LOG_LEVEL);

static struct server_context srv_context = {
	.ot = NULL,
	.not_safe_enable = true,
	.dodgy_pig_enable = true,
};

static void coap_default_handler(void *context, otMessage *message, const otMessageInfo *message_info){
	ARG_UNUSED(context);
    
	otError error;
	otMessageInfo msg_info;

	LOG_INF("Received CoAP message that does not match any request or resource");

	msg_info = *message_info;
	memset(&msg_info.mSockAddr, 0, sizeof(msg_info.mSockAddr));
	error = coap_default_response(srv_context.ot, message, &msg_info);
}

int ot_coap_init(bool not_safe_enable, bool dodgy_pig_enable, bool divorce_confirmation_enable){
	otError error;
	
	srv_context.ot = openthread_get_default_instance();
	if (!srv_context.ot) {
		LOG_ERR("There is no valid OpenThread instance");
		error = OT_ERROR_FAILED;
		goto end;
	}

	otCoapResource* not_safe_resource = not_safe_init(srv_context.ot, not_safe_enable);
	otCoapResource* dodgy_pig_resource = dodgy_pig_init(srv_context.ot, dodgy_pig_enable);
	otCoapResource* divorce_confirmation_resource = divorce_confirmation_init(srv_context.ot, divorce_confirmation_enable);

	otCoapSetDefaultHandler(srv_context.ot, coap_default_handler, NULL);
	otCoapAddResource(srv_context.ot, not_safe_resource);
	otCoapAddResource(srv_context.ot, dodgy_pig_resource);
	otCoapAddResource(srv_context.ot, divorce_confirmation_resource);

	error = otCoapStart(srv_context.ot, COAP_PORT);
	if (error != OT_ERROR_NONE) {
		LOG_ERR("Failed to start OT CoAP. Error: %d", error);
		goto end;
	}

end:
	return error == OT_ERROR_NONE ? 0 : 1;
}
```

## src/ot_coap_utils.h
```c
#ifndef __OT_COAP_UTILS_H__
#define __OT_COAP_UTILS_H__

#include "ot_common.h"
#include "ot_coap_example_1.h"
#include "ot_coap_example_2.h"
#include "ot_coap_example_3.h"

/**@brief Type definition of the function used to handle resources change.
 */

struct server_context {
	struct otInstance *ot;
	bool not_safe_enable;
	bool dodgy_pig_enable;
};

int ot_coap_init(bool not_safe_enable, bool dodgy_pig_enable, bool divorce_confirmation_enable);

#endif
```

## src/ot_common.c
```c
#include "ot_common.h"

LOG_MODULE_REGISTER(ot_common, CONFIG_OT_COAP_UTILS_LOG_LEVEL);

otError coap_default_response(struct otInstance *ot, otMessage *request_message, const otMessageInfo *message_info){
	otError error = OT_ERROR_NO_BUFS;
	otMessage *response;

	response = otCoapNewMessage(ot, NULL);
	if (response == NULL) {
		goto end;
	}

    //Init a response message with same message ID and token
    error = otCoapMessageInitResponse(
        response, 
        request_message,
        OT_COAP_TYPE_RESET,
        OT_COAP_CODE_EMPTY
    );
    if (error != OT_ERROR_NONE) {
		goto end;
	}

	error = otCoapSendResponse(ot, response, message_info);
	if (error != OT_ERROR_NONE) {
		goto end;
	}
    
	LOG_INF("Sent CoAP Reset message");

end:
	if (error != OT_ERROR_NONE && response != NULL) {
		otMessageFree(response);
	}

	return error;
}
```

## src/ot_common.h
```c
#ifndef __OT_COMMON_H__
#define __OT_COMMON_H__

#include <coap_server_client_interface.h>
#include <logging/log.h>
#include <net/net_pkt.h>
#include <net/net_l2.h>
#include <net/openthread.h>
#include <openthread/coap.h>
#include <openthread/ip6.h>
#include <openthread/message.h>
#include <openthread/thread.h>

typedef void (*function)();

struct example_srv_context {
	otCoapResource resource;
	bool enable;
	function callback; 
};

otError coap_default_response(struct otInstance *ot, otMessage *request_message, const otMessageInfo *message_info);

#endif
```
